## config/west.yml
```yaml
manifest:
  remotes:
    - name: slicemk
      url-base: https://github.com/wdtamagi
  projects:
    - name: slice-zmk
      remote: slicemk
      revision: v20220204-dactyl
      import: app/west.yml
  self:
    path: config
```
